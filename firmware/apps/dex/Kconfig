## firmware/apps/mdb/Kconfig
```kconfig
#
# For a description of the syntax of this configuration file,
# see the file kconfig-language.txt in the NuttX tools repository.
#

config VMFLOW_MDB
	tristate "MDB cashless engine (mdb)"
	default n
	depends on !DISABLE_MQUEUE
	---help---
		Answers the vending machine as an MDB level 1 cashless device on
		the bus driver (/dev/mdb0), like mdb_cashless_task() in the
		ESP-IDF firmware. Any task drives it through a message queue
		(mdb.h, or the "mdb" command): open a session with credit, let
		the app approve each vend, cancel, and so on.

if VMFLOW_MDB

config VMFLOW_MDB_PROGNAME
	string "Program name"
	default "mdb"

config VMFLOW_MDB_PRIORITY
	int "Engine task priority"
	default 200
	---help---
		The VMC wants an answer within 5 ms; keep it above the network
		and modem tasks.

config VMFLOW_MDB_STACKSIZE
	int "Stack size"
	default 2048

config VMFLOW_MDB_AUTOSTART
	bool "Start at boot (nxinit service)"
	default y
	depends on SYSTEM_NXINIT
	---help---
		Run "mdb" as an nxinit service from /etc/init.d/init.rc.

config VMFLOW_MDB_DEVPATH
	string "MDB bus device"
	default "/dev/mdb0"

choice
	prompt "Peripheral address"
	default VMFLOW_MDB_CASHLESS_1

config VMFLOW_MDB_CASHLESS_1
	bool "Cashless device #1 (0x10)"

config VMFLOW_MDB_CASHLESS_2
	bool "Cashless device #2 (0x60)"

endchoice

config VMFLOW_MDB_ADDRESS
	int
	default 16 if VMFLOW_MDB_CASHLESS_1
	default 96 if VMFLOW_MDB_CASHLESS_2

choice
	prompt "Country / currency code"
	default VMFLOW_MDB_CURRENCY_UNKNOWN

config VMFLOW_MDB_CURRENCY_EUR
	bool "EUR - 0x1978"

config VMFLOW_MDB_CURRENCY_USD
	bool "USD - 0x1840"

config VMFLOW_MDB_CURRENCY_BRL
	bool "BRL - 0x1986"

config VMFLOW_MDB_CURRENCY_UNKNOWN
	bool "Unknown - 0xffff"

endchoice

config VMFLOW_MDB_CURRENCY_CODE
	int
	default 6520 if VMFLOW_MDB_CURRENCY_EUR
	default 6208 if VMFLOW_MDB_CURRENCY_USD
	default 6534 if VMFLOW_MDB_CURRENCY_BRL
	default 65535 if VMFLOW_MDB_CURRENCY_UNKNOWN

choice
	prompt "Scale factor"
	default VMFLOW_MDB_SCALE_1

config VMFLOW_MDB_SCALE_1
	bool "1"

config VMFLOW_MDB_SCALE_10
	bool "10"

config VMFLOW_MDB_SCALE_100
	bool "100"

endchoice

config VMFLOW_MDB_SCALE_FACTOR
	int
	default 1 if VMFLOW_MDB_SCALE_1
	default 10 if VMFLOW_MDB_SCALE_10
	default 100 if VMFLOW_MDB_SCALE_100

config VMFLOW_MDB_DECIMAL_PLACES
	int "Decimal places"
	default 2
	range 0 3

config VMFLOW_MDB_SESSION_TIMEOUT
	int "Session inactivity timeout (s)"
	default 60
	---help---
		A session with no vend activity for this long is cancelled. Each
		vend request and outcome restarts the count.

config VMFLOW_MDB_APPROVE_TIMEOUT
	int "Vend approval timeout (s)"
	default 8
	range 1 255
	---help---
		A vend in an "open" session that gets no approve/deny for this
		long is denied. Keep it below the response time reported to the
		VMC, so the reader answers before the VMC gives up.

config VMFLOW_MDB_RESPONSE_TIME
	int "Maximum response time reported to the VMC (s)"
	default 10
	range 1 255
	---help---
		Sent in READER CONFIG DATA: how long the VMC waits for the
		reader, notably for a vend approval. The ESP-IDF firmware sends
		3; an approval that crosses LTE-M needs more.

config VMFLOW_MDB_BUS_TIMEOUT
	int "Bus silence timeout (s)"
	default 5
	---help---
		With no frame for the reader for this long (machine off, cable
		out), the reader drops to inactive, the session ends and the
		next poll is answered with JUST RESET.

config VMFLOW_MDB_CREDIT_TIMEOUT
	int "Pending credit timeout (s)"
	default 120
	---help---
		A credit that finds no session for this long (reader not
		enabled) is dropped, with a credit_expired event so the sender
		can give it back. Each new credit restarts the count.

config VMFLOW_MDB_WATCHDOG
	bool "Hardware watchdog"
	default y
	depends on WATCHDOG
	---help---
		The engine starts the watchdog and feeds it at least once a
		second. If the engine stops (and init does not bring it back in
		time), the board resets.

config VMFLOW_MDB_WATCHDOG_DEVPATH
	string "Watchdog device"
	default "/dev/watchdog0"
	depends on VMFLOW_MDB_WATCHDOG

config VMFLOW_MDB_WATCHDOG_TIMEOUT
	int "Watchdog timeout (s)"
	default 10
	depends on VMFLOW_MDB_WATCHDOG

endif
```

## firmware/apps/sim7080g/Kconfig
```kconfig
#
# For a description of the syntax of this configuration file,
# see the file kconfig-language.txt in the NuttX tools repository.
#

config SIM7080G
	tristate "SIM7080G LTE-M / NB-IoT modem daemon"
	default n
	depends on NET_UDP && NET_IPv4 && DEV_GPIO
	select NETUTILS_PPPD
	select NETUTILS_NETLIB
	---help---
		Powers the SIM7080G, runs pppd over its UART and supervises the
		PPP link. Once IPCP is up the modem is a regular network interface
		(ppp0): sockets, DNS, MQTT and TLS work without knowing about it.

if SIM7080G

config SIM7080G_PROGNAME
	string "Program name"
	default "sim7080g"

config SIM7080G_PRIORITY
	int "Daemon task priority"
	default 100

config SIM7080G_STACKSIZE
	int "Daemon stack size"
	default 2048

config SIM7080G_PPP_PRIORITY
	int "pppd task priority"
	default 100

config SIM7080G_PPP_STACKSIZE
	int "pppd stack size"
	default 4096

config SIM7080G_TTY
	string "Modem serial device"
	default "/dev/ttyS1"

config SIM7080G_PWRKEY
	string "PWRKEY GPIO device"
	default "/dev/sim7080g_pwrkey"

config SIM7080G_APN
	string "APN"
	default "lf.br"

choice
	prompt "LTE network mode"
	default SIM7080G_CMNB_BOTH

config SIM7080G_CMNB_CATM
	bool "Cat-M only"

config SIM7080G_CMNB_NBIOT
	bool "NB-IoT only"

config SIM7080G_CMNB_BOTH
	bool "Both (LTE-M + NB-IoT)"

endchoice

config SIM7080G_CMNB
	int
	default 1 if SIM7080G_CMNB_CATM
	default 2 if SIM7080G_CMNB_NBIOT
	default 3 if SIM7080G_CMNB_BOTH

config SIM7080G_LINK_TIMEOUT
	int "Seconds without link before toggling PWRKEY"
	default 300
	---help---
		pppd retries the connect script on its own (every 10 s, plus a
		45 s pause after 15 failures). If ppp0 still has no address after
		this many seconds, the daemon pulses PWRKEY to power-cycle a stuck
		modem.

if NETUTILS_PPPD_PAP

config SIM7080G_PAP_USERNAME
	string "PAP username"
	default ""

config SIM7080G_PAP_PASSWORD
	string "PAP password"
	default ""

endif # NETUTILS_PPPD_PAP

endif # SIM7080G
```

## firmware/apps/vmflow/Kconfig
```kconfig
#
# For a description of the syntax of this configuration file,
# see the file kconfig-language.txt in the NuttX tools repository.
#

config VMFLOW
	tristate "VMflow orchestrator"
	default n
	depends on NET_TCP && NETDB_DNSCLIENT
	select NETUTILS_MQTTC
	---help---
		Ties the VMflow backend (MQTT) and the phone app (BLE) to the MDB
		engine, the dex audit reader, the buzzer and the status LED, as
		the ESP-IDF firmware does. It only talks to them through their
		public interfaces (mdb.h, the dex command, device files), so the
		rest of the system runs without it.

if VMFLOW

config VMFLOW_PROGNAME
	string "Program name"
	default "vmflow"

config VMFLOW_PRIORITY
	int "Task priority"
	default 100

config VMFLOW_STACKSIZE
	int "Stack size (MQTT client)"
	default 4096

config VMFLOW_MACHINE_STACKSIZE
	int "Stack size of the MDB event thread"
	default 3072

config VMFLOW_AUTOSTART
	bool "Start at boot (nxinit service)"
	default y
	depends on SYSTEM_NXINIT
	---help---
		Run "vmflow" as an nxinit service from /etc/init.d/init.rc. It
		waits for its identity files and for the network on its own.

config VMFLOW_DATADIR
	string "Identity directory"
	default "/data/vmflow"
	---help---
		Holds "subdomain" (the numeric device id of the backend,
		<subdomain>.vmflow.xyz) and "passkey" (RPC and BLE signing key),
		one value per file:
		  echo 123 > /data/vmflow/subdomain
		The ESP-IDF firmware keeps them in NVS.

config VMFLOW_BUZZER_DEVPATH
	string "Buzzer GPIO device"
	default "/dev/gpio0"

config VMFLOW_LED_DEVPATH
	string "Status LED device"
	default "/dev/leds0"

config VMFLOW_DEX_COMMAND
	string "Audit reader command"
	default "dex"
	---help---
		Builtin run for the "dex" RPC; its stdout is the audit.

config VMFLOW_BLE
	bool "BLE for the phone app"
	default y
	depends on NIMBLE && NIMBLE_ROLE_PERIPHERAL
	---help---
		GATT peripheral of the ESP-IDF firmware (same service): BLE
		provisioning of subdomain and passkey, app sessions with signed
		vend approval, and vend notifications. Builds NimBLE into vmflow.

config VMFLOW_BLE_IFNAME
	string "BLE controller network interface"
	default "bnep0"
	depends on VMFLOW_BLE

config VMFLOW_BLE_STACKSIZE
	int "Stack size of the NimBLE host and HCI threads"
	default 4096
	depends on VMFLOW_BLE

config VMFLOW_MQTT_HOST
	string "Broker host"
	default "mqtt.vmflow.xyz"

config VMFLOW_MQTT_PORT
	int "Broker port"
	default 1883

config VMFLOW_MQTT_KEEPALIVE
	int "Keepalive (s)"
	default 120

config VMFLOW_MQTT_RECONNECT
	int "Seconds between connection attempts"
	default 15

config VMFLOW_MQTT_SENDBUF
	int "Send buffer size"
	default 10240
	---help---
		MQTT-C keeps every outgoing message here until it is
		acknowledged. A DEX audit (up to the dex buffer, 8 KB) goes out
		as one message; larger audits are cut to fit.

config VMFLOW_MQTT_RECVBUF
	int "Receive buffer size"
	default 2048
	---help---
		Largest incoming message (topic + payload).

endif
```

## firmware/boards/vmflow-esp32s3/Kconfig
```kconfig
#
# For a description of the syntax of this configuration file,
# see the file kconfig-language.txt in the NuttX tools repository.
#

if ARCH_BOARD_CUSTOM

config VMFLOW_SIM7080G_PWRKEY_GPIO
	int "SIM7080G PWRKEY GPIO"
	default 14
	depends on DEV_GPIO
	---help---
		GPIO driving the SIM7080G PWRKEY through an inverting transistor
		(high = key pressed). Exposed as /dev/sim7080g_pwrkey.

config VMFLOW_RGBLED_GPIO
	int "RGB LED (WS2812) GPIO"
	default 21
	depends on ESP_RMT
	---help---
		Data pin of the addressable RGB LED, driven by an RMT TX channel.
		Exposed as /dev/leds0 when WS2812_NON_SPI_DRIVER is enabled.

config VMFLOW_MDB_DEVICE
	bool "MDB bus driver (/dev/mdb0)"
	default n
	select ESPRESSIF_GPIO_IRQ
	---help---
		Bit-banged 9-bit MDB bus at 9600 baud, read and written as
		uint16_t words (bit 8 = mode bit) through /dev/mdb0. Used by the
		mdb engine.

if VMFLOW_MDB_DEVICE

config VMFLOW_MDB_RX_GPIO
	int "MDB RX GPIO"
	default 4

config VMFLOW_MDB_TX_GPIO
	int "MDB TX GPIO"
	default 5

endif # VMFLOW_MDB_DEVICE

endif # ARCH_BOARD_CUSTOM
```
